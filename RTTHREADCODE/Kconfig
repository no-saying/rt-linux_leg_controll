## RTTHREADCODE/Kconfig
```kconfig
mainmenu "RT-Thread Configuration for RK3568 AMP"

config SOC_RK3568
    bool
    default y

source "$RTT_DIR/Kconfig"
source "$RTT_DIR/bsp/rockchip/dm/Kconfig"
```
